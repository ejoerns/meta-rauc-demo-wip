## meta-rauc-qemux86/wic/qemux86-grub-efi.wks
```
# short-description: Create Qemu disk image
# long-description: Creates a partitioned Qemu disk image for use with the RAUC
# update tool. The partitionging scheme provides:
# * two root file system partitions for atomic updates
# * a rescue partition
# * a bootloader partition
# * a common data partition

bootloader --ptable gpt
part --fixed-size 50M --source rootfs --rootfs-dir=${IMAGE_ROOTFS}/boot --fstype=vfat --ondisk sda --label boot --active --align 4096
part /efienv --fixed-size 10M --fstype=vfat --ondisk sda --label env --align 4096
part /rescue --source rootfs --ondisk sda --fstype=ext4 --label rescue --align 1024
part / --source rootfs --ondisk sda --fstype=ext4 --label root_a --align 4096
part / --source rootfs --ondisk sda --fstype=ext4 --label root_b --align 4096
part /data --fixed-size 50M --ondisk sda --fstype=ext4 --label data --align 4096
```

## meta-rauc-raspberrypi/wic/sdimage-rauc-raspberrypi.wks
```
# short-description: Create Raspberry Pi RAUC demo SD card image
# long-description: Creates a partitioned SD card image for use with
# Raspberry Pi.
# Boot files are located in the first vfat partition. We leave some extra space for updating boot files
# root_a and root_b are redundant root file system partitions
# data is a non-redundant data partition

part --fixed-size 50M --source bootimg-partition --ondisk mmcblk0 --fstype=vfat --label boot --active --align 4096
# start partition at 104MB to leav space for the boot partition shadow copy
part / --fixed-size 200M --source rootfs --ondisk mmcblk0 --fstype=ext4 --label root_a --align 106496
part --fixed-size 200M --source rootfs --ondisk mmcblk0 --fstype=ext4 --label root_b --align 4096
part /data --size 100M --ondisk mmcblk0 --fstype=ext4 --label data --align 4096
```
